## drivers/Kconfig
```kconfig
# Copyright (c) 2024 CATIE
# SPDX-License-Identifier: Apache-2.0

menu "Device Drivers"

rsource "fuel_gauge/Kconfig"

endmenu
```

## drivers/fuel_gauge/Kconfig
```kconfig
# Copyright (c) 2024 CATIE
# SPDX-License-Identifier: Apache-2.0

if FUEL_GAUGE

rsource "maxim/Kconfig"

endif # FUEL_GAUGE
```

## drivers/fuel_gauge/maxim/max17201/Kconfig
```kconfig
# Copyright (c) 2024 CATIE
# SPDX-License-Identifier: Apache-2.0

menuconfig MAX17201
    bool "Zephyr Maxim MAX17201 Fuel Gauge Driver"
    default y
    depends on DT_HAS_MAXIM_MAX17201_ENABLED
    select I2C
    help
      Enable driver for Zephyr Maxim MAX17201 Fuel Gauge Driver.

if MAX17201

config MAX17201_INTERNAL_TEMP
    bool "Enable internal temperature measure"
    default n
    depends on MAX17201
    help
      Enable MAX17201 to measure internal temperature

choice
    prompt "Fuel Gauge Temp input"
    default MAX17201_FG_INPUT_EXTERNAL

config MAX17201_FG_INPUT_INTERNAL
    bool "Internal Temperature input"
    depends on MAX17201

config MAX17201_FG_INPUT_EXTERNAL
    bool "External Thermistors input"
    depends on MAX17201

config MAX17201_FG_INPUT_REGISTER
    bool "Registers input"
    depends on MAX17201

endchoice

endif # MAX17201
```

## dts/bindings/sensor/maxim,max17201.yaml
```yaml
# Copyright (c) 2024 CATIE
# SPDX-License-Identifier: Apache-2.0

description: |
    Zephyr Maxim MAX17201 Fuel Gauge Driver

compatible: "maxim,max17201"

on-bus: i2c

include:
  - name: fuel-gauge.yaml
  - name: i2c-device.yaml

properties:
  sbs:
    type: int
    required: true
    const: 0x0B
    description: SBS MAX17201 I2C address.
  nb-cell:
    type: int
    required: true
    const: 1
    description: MAX17201 number of cells managed.
  rshunt:
    type: int
    required: true
    description: Shunt resistance in mΩ.
  capacity:
    type: int
    required: true
    description: Cells max capacity in mAh.
  empty-voltage:
    type: int
    required: true
    description: Voltage threshold for empty detection in mV.
  voltage-thresholds:
    type: array
    description: Voltage thresholds [MIN, MAX] for alert detection in mV.
    default: [3600, 4250]
  current-thresholds:
    type: array
    description: Current thresholds [MIN, MAX] for alert detection in mA.
    default: [-800, 800]
  temperature-thresholds:
    type: array
    description: Temperature thresholds [MIN, MAX] for alert detection in 0.1K.
    default: [2732, 3181]
  external-thermistor1:
    type: boolean
    description: Enable external thermistor 1.
  external-thermistor2:
    type: boolean
    description: Enable external thermistor 2.
  ntc-thermistors:
    type: string
    description: Select NTC curve.
    enum:
        - "Murata"
        - "Fenwal"
        - "TDK"
    default: "Murata"
  alert-gpios:
    type: phandle-array
    description: MAX17201 alart signal.
```
